## west.yml
```yaml
manifest:
  defaults:
    remote: rose

  remotes:
    - name: rose
      url-base: https://github.com/rose-project
    - name: openembedded
      url-base: https://git.openembedded.org

  projects:
    - name: bitbake
      path: tools/bitbake
      remote: openembedded
      revision: "acfe02fa38b5da9e6a36c6cedcf91d4fcbefbfbd" # yocto-6.0.2 (2.18.0)
      clone-depth: 1
    - name: openembedded-core
      path: layers/openembedded-core
      remote: openembedded
      revision: "5d1aa5c806c061a2994f4decb59016610f093213" # yocto-6.0.2 (wrynose)
      clone-depth: 1
    - name: meta-openembedded
      path: layers/meta-openembedded
      remote: openembedded
      revision: "14282a02be9c74a1276a7cda7d6c89e054699a11" # wrynose branch tip 2026-07-31 (no release tags in meta-oe)
      clone-depth: 1
    - name: meta-rose
      path: layers/meta-rose
      remote: rose
      revision: master
    - name: meta-raspberrypi-bsp
      path: layers/meta-raspberrypi-bsp
      remote: rose
      revision: master
    - name: meta-x86-64-bsp
      path: layers/meta-x86-64-bsp
      remote: rose
      revision: master

  self:
    path: config
```
